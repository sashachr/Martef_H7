/*   0                */ {0},
/*   1 STATE          */ {4, TYPE_UINT32|VF_PROPREAD, 0, GetStatus, 0},
/*   2 ASTATE         */ {NAX, TYPE_UINT32|VF_DIRECTREAD|VF_DIRECTWRITE, ServoDirectReadWrite(RState)},
/*   3 FSTATE         */ {NAX, TYPE_UINT32|VF_DIRECTREAD, ServoDirectRead(FState)},
/*   4 FAULT          */ {0},
/*   5 AFAULT         */ {NAX, TYPE_UINT32|VF_DIRECTREAD|VF_DIRECTWRITE, ServoDirectReadWrite(Fault)},
/*   6 HEALTH         */ {0},
/*   7 AHEALTH        */ {NAX, TYPE_UINT32|VF_DIRECTREAD, ServoDirectRead(PreFault)},
/*   8                */ {0},
/*   9                */ {0},
/*  10 TICK           */ {1, TYPE_UINT32|VF_DIRECTREAD|VF_DIRECTWRITE, StructScalarDirectReadWrite(Time, Tick)},
/*  11 TIME           */ {1, TYPE_FLOAT|VF_PROPREAD|VF_PROPWRITE, 0, [](uint16_t, uint16_t, int32_t* buf) -> int32_t { *(float*)buf = Time.GetTime(); }, [](uint16_t, uint16_t count, int32_t* buf) -> int32_t { Time.SetTime(*(float*)buf); return 1; }},
/*  12                */ {0},
/*  13                */ {0},
/*  14                */ {0},
/*  15                */ {0},
/*  16                */ {0},
/*  17                */ {0},
/*  18                */ {0},
/*  19                */ {0},
/*  20                */ {0},
/*  21                */ {0},
/*  22                */ {0},
/*  23                */ {0},
/*  24                */ {0},
/*  25                */ {0},
/*  26                */ {0},
/*  27                */ {0},
/*  28                */ {0},
/*  29                */ {0},
/*  30                */ {0}, // {MaxMrt, TYPE_UINT32|VF_DIRECTREAD|VF_PROPWRITE, (int32_t*)MrtBuf, MrtWrite},
/*  31                */ {0}, // {1, TYPE_UINT32|VF_PROPREAD, 0, MrtValidate},
/*  32                */ {0},
/*  33                */ {0},
/*  34                */ {0},
/*  35                */ {0},
/*  36                */ {0},
/*  37                */ {0},
/*  38                */ {0},
/*  39                */ {0},
/*  40 __scope        */ {32064, TYPE_UINT32|VF_PROPREAD|VF_PROPWRITE, 0, [](uint16_t, uint16_t, int32_t* buf) -> int32_t { return Scope.Read(buf); }, [](uint16_t, uint16_t count, int32_t* buf) -> int32_t { return Scope.Configure(buf, count); }},
/*  41                */ {0},
/*  42                */ {0},
/*  43                */ {0},
/*  44                */ {0},
/*  45                */ {0},
/*  46                */ {0},
/*  47                */ {0},
/*  48                */ {0},
/*  49                */ {0},
/*  50                */ {0},
/*  51                */ {0},
/*  52                */ {0},
/*  53                */ {0},
/*  54                */ {0},
/*  55                */ {0},
/*  56                */ {0},
/*  57                */ {0},
/*  58                */ {0},
/*  59                */ {0},
/*  60                */ {0},
/*  61                */ {0},
/*  62                */ {0},
/*  63                */ {0},
/*  64                */ {0},
/*  65                */ {0},
/*  66                */ {0},
/*  67                */ {0},
/*  68                */ {0},
/*  69                */ {0},
/*  70 __flkey        */ {1, TYPE_UINT32|VF_PROPREAD|VF_PROPWRITE, 0, [](uint16_t, uint16_t, int32_t* buf) -> int32_t { *buf = FlashIsLocked() ? 0 : 0x27A284F9; return 1; }, [](uint16_t, uint16_t, int32_t* buf) -> int32_t { if (*buf == 0x27A284F9) FlashUnlock(); else FlashLock(); return 1; }},
/*  71 __flsave       */ {1, TYPE_UINT32|VF_PROPREAD|VF_PROPWRITE, 0, [](uint16_t, uint16_t, int32_t* buf) -> int32_t { *buf = FlashOperationInProgress; return 1; }, [](uint16_t, uint16_t, int32_t* buf) -> int32_t { return FlashOperation(*buf); }},
/*  72                */ {0}, // {1, TYPE_UINT8|VF_PROPREAD|VF_PROPWRITE, 0, FlashSave},
/*  73                */ {0},
/*  74                */ {0},
/*  75                */ {0},
/*  76                */ {0},
/*  77                */ {0},
/*  78                */ {0},
/*  79                */ {0},
/*  80                */ {0},
/*  81                */ {0},
/*  82                */ {0},
/*  83                */ {0},
/*  84                */ {0},
/*  85                */ {0},
/*  86                */ {0},
/*  87                */ {0},
/*  88                */ {0},
/*  89                */ {0},
/*  90                */ {0},
/*  91                */ {0},
/*  92                */ {0},
/*  93                */ {0},
/*  94                */ {0},
/*  95                */ {0},
/*  96                */ {0},
/*  97                */ {0},
/*  98                */ {0},
/*  99 ENABLE         */ {NAX, TYPE_UINT32|VF_PROPREAD|VF_PROPWRITE, 0, StructReadBit(Servo, RState, NAX, 1), StructWriteBit(Servo, RState, NAX, 1) },
/* 100                */ {0},
/* 101 VEL            */ {NAX, TYPE_FLOAT|VF_DIRECTREAD|VF_DIRECTWRITE|VF_FLASH|CAT_VEL, ServoDirectReadWrite(Vel)},
/* 102 ACC            */ {NAX, TYPE_FLOAT|VF_DIRECTREAD|VF_DIRECTWRITE|VF_FLASH|CAT_ACC, ServoDirectReadWrite(Acc)},
/* 103 DEC            */ {NAX, TYPE_FLOAT|VF_DIRECTREAD|VF_DIRECTWRITE|VF_FLASH|CAT_ACC, ServoDirectReadWrite(Dec)},
/* 104 KDEC           */ {NAX, TYPE_FLOAT|VF_DIRECTREAD|VF_DIRECTWRITE|VF_FLASH|CAT_ACC, ServoDirectReadWrite(KDec)},
/* 105 JERK           */ {NAX, TYPE_FLOAT|VF_DIRECTREAD|VF_DIRECTWRITE|VF_FLASH|CAT_JERK, ServoDirectReadWrite(Jerk)},
/* 106                */ {0},
/* 107                */ {0},
/* 108                */ {0},
/* 109                */ {0},
/* 110 RPOS           */ {NAX, TYPE_FLOAT|VF_DIRECTREAD|VF_PROPWRITE|CAT_POS, ServoDirectRead(RPos4), ServoSetPos},
/* 111 RVEL           */ {NAX, TYPE_FLOAT|VF_DIRECTREAD|VF_PROPWRITE|CAT_VEL, ServoDirectRead(RVel), 0},
/* 112 RACC           */ {NAX, TYPE_FLOAT|VF_DIRECTREAD|CAT_ACC, ServoDirectRead(RAcc), 0},
/* 113 RJERK          */ {NAX, TYPE_FLOAT|VF_DIRECTREAD|CAT_JERK, ServoDirectRead(RJerk), 0},
/* 114                */ {0},
/* 115 TPOS           */ {NAX, TYPE_FLOAT|VF_DIRECTREAD|VF_PROPWRITE|CAT_POS, ServoDirectRead(TPos), ServoSetTPos},
/* 116 TVEL           */ {NAX, TYPE_FLOAT|VF_DIRECTREAD|VF_DIRECTWRITE|CAT_VEL, ServoDirectReadWrite(TVel)},
/* 117                */ {0},
/* 118                */ {0},
/* 119 FPOS1          */ {NAX, TYPE_FLOAT|VF_DIRECTREAD|VF_PROPWRITE|CAT_POS1, ServoDirectRead(FPos1), 0},
/* 120 FPOS           */ {NAX, TYPE_FLOAT|VF_DIRECTREAD|VF_PROPWRITE|CAT_POS, ServoDirectRead(FPos), WriteFpos},
/* 121 FVEL           */ {NAX, TYPE_FLOAT|VF_DIRECTREAD|CAT_VEL, ServoDirectRead(FFVel), 0},
/* 122 FACC           */ {NAX, TYPE_FLOAT|VF_DIRECTREAD|CAT_ACC, ServoDirectRead(FAcc), 0},
/* 123 FCA            */ {NAX, TYPE_FLOAT|VF_DIRECTREAD|CAT_PERCENT, ServoDirectRead(FCa), 0},
/* 124 FCB            */ {NAX, TYPE_FLOAT|VF_DIRECTREAD|CAT_PERCENT, ServoDirectRead(FCb), 0},
/* 125 FCD            */ {NAX, TYPE_FLOAT|VF_DIRECTREAD|CAT_PERCENT, ServoDirectRead(FCd), 0},
/* 126 FCQ            */ {NAX, TYPE_FLOAT|VF_DIRECTREAD|CAT_PERCENT, ServoDirectRead(FCq), 0},
/* 127 PE             */ {NAX, TYPE_FLOAT|VF_DIRECTREAD|CAT_POS, ServoDirectRead(Pe), 0},
/* 128 VE             */ {NAX, TYPE_FLOAT|VF_DIRECTREAD|CAT_VEL, ServoDirectRead(Ve), 0},
/* 129 NFVEL          */ {NAX, TYPE_FLOAT|VF_DIRECTREAD|CAT_VEL, ServoDirectRead(FVel), 0},
/* 130                */ {0},    //    {DirectFull(NAX, Srv, Control.KP)},
/* 131 VIN            */ {NAX, TYPE_FLOAT|VF_DIRECTREAD|VF_PROPWRITE|CAT_VEL, ServoDirectRead(VIn), ServoSetVel},
/* 132 CIN            */ {NAX, TYPE_FLOAT|VF_DIRECTREAD|VF_PROPWRITE|CAT_PERCENT, ServoDirectRead(CIn), ServoSetCur},
/* 133 CDOUT          */ {NAX, TYPE_FLOAT|VF_DIRECTREAD|CAT_PERCENT, ServoDirectRead(CdOut), 0},
/* 134 CQOUT          */ {NAX, TYPE_FLOAT|VF_DIRECTREAD|VF_PROPWRITE|CAT_PERCENT, ServoDirectRead(CqOut), ServoSetCurQ},
/* 135 OUTA           */ {NAX, TYPE_FLOAT|VF_DIRECTREAD|CAT_PERCENT, ServoDirectRead(OutA), 0},
/* 136 OUTB           */ {NAX, TYPE_FLOAT|VF_DIRECTREAD|CAT_PERCENT, ServoDirectRead(OutB), 0},
/* 137 OUTC           */ {NAX, TYPE_FLOAT|VF_DIRECTREAD|CAT_PERCENT, ServoDirectRead(OutC), 0},
/* 138 COMA           */ {NAX, TYPE_FLOAT|VF_DIRECTREAD|VF_PROPWRITE, ServoDirectRead(Teta), ServoSetTeta},
/* 139                */ {0},
/* 140                */ {0},    //   {NAX, DirectSingleRead(Srv, Control.CurL1.Pi.KP), CurLoopWrite(Pi.KP), CurLopReadWrite(Pi.KP)},
/* 141                */ {0},    //   {NAX, DirectSingleRead(Srv, Control.CurL1.Pi.KI), CurLoopWrite(Pi.KI), CurLopReadWrite(Pi.KI)},
/* 142                */ {0},    //   {NAX, DirectSingleRead(Srv, Control.CurL1.Pi.LI), CurLoopWrite(Pi.LI), CurLopReadWrite(Pi.LI)},
/* 143                */ {0},
/* 144                */ {0},
/* 145                */ {0},
/* 146                */ {0},
/* 147                */ {0},
/* 148                */ {0},
/* 149                */ {0},
/* 150 BQAENABLE      */ {0},  // {1, TYPE_UINT8|VF_DIRECTREAD|VF_DIRECTWRITE|VF_FLASH, (int32_t*)&Servo.BqAc.Enable, 0},
/* 151 BQAMODE        */ {0},  // {1, TYPE_UINT8|VF_DIRECTREAD|VF_DIRECTWRITE|VF_FLASH, (int32_t*)&Servo.BqAc.Mode, 0},
/* 152 BQAA1          */ {0},  // {1, TYPE_FLOAT|VF_DIRECTREAD|VF_DIRECTWRITE|VF_FLASH, (int32_t*)&Servo.BqAc.A1, 0},
/* 153 BQAA2          */ {0},  // {1, TYPE_FLOAT|VF_DIRECTREAD|VF_DIRECTWRITE|VF_FLASH, (int32_t*)&Servo.BqAc.A2, 0},
/* 154 BQAB0          */ {0},  // {1, TYPE_FLOAT|VF_DIRECTREAD|VF_DIRECTWRITE|VF_FLASH, (int32_t*)&Servo.BqAc.B0, 0},
/* 155 BQAB1          */ {0},  // {1, TYPE_FLOAT|VF_DIRECTREAD|VF_DIRECTWRITE|VF_FLASH, (int32_t*)&Servo.BqAc.B1, 0},
/* 156 BQAB2          */ {0},  // {1, TYPE_FLOAT|VF_DIRECTREAD|VF_DIRECTWRITE|VF_FLASH, (int32_t*)&Servo.BqAc.B2, 0},
/* 157                */ {0},
/* 158                */ {0},
/* 159                */ {0},
/* 160 BQDENABLE      */ {0},  // 	{1, TYPE_UINT8|VF_DIRECTREAD|VF_DIRECTWRITE|VF_FLASH, (int32_t*)&Servo.BqDc.Enable, 0},
/* 161 BQDMODE        */ {0},  // 	{1, TYPE_UINT8|VF_DIRECTREAD|VF_DIRECTWRITE|VF_FLASH, (int32_t*)&Servo.BqDc.Mode, 0},
/* 162 BQDA1          */ {0},  // 	{1, TYPE_FLOAT|VF_DIRECTREAD|VF_DIRECTWRITE|VF_FLASH, (int32_t*)&Servo.BqDc.A1, 0},
/* 163 BQDA2          */ {0},  // 	{1, TYPE_FLOAT|VF_DIRECTREAD|VF_DIRECTWRITE|VF_FLASH, (int32_t*)&Servo.BqDc.A2, 0},
/* 164 BQDB0          */ {0},  // 	{1, TYPE_FLOAT|VF_DIRECTREAD|VF_DIRECTWRITE|VF_FLASH, (int32_t*)&Servo.BqDc.B0, 0},
/* 165 BQDB1          */ {0},  // 	{1, TYPE_FLOAT|VF_DIRECTREAD|VF_DIRECTWRITE|VF_FLASH, (int32_t*)&Servo.BqDc.B1, 0},
/* 166 BQDB2          */ {0},  // 	{1, TYPE_FLOAT|VF_DIRECTREAD|VF_DIRECTWRITE|VF_FLASH, (int32_t*)&Servo.BqDc.B2, 0},
/* 167                */ {0},
/* 168                */ {0},
/* 169                */ {0},
/* 170                */ {0},    //   {DirectIntFull(NAX, Srv, Control.VelL.Bq1.Mode, int16_t)},
/* 171                */ {0},    //   {DirectIntFull(NAX, Srv, Control.VelL.Bq2.Mode, int16_t)},
/* 172                */ {0},    //   {DirectIntFull(NAX, Motions, VelocityProfileMode, uint16_t)},
/* 173                */ {0},    //   {DirectIntFull(NAX, Srv, UpdateAtIndex, uint16_t)},
/* 174                */ {0},    //   {DirectIntFull(NAX, Srv, Control.Simulate, uint16_t)},
/* 175                */ {0},
/* 176                */ {0},
/* 177                */ {0},
/* 178                */ {0},
/* 179 VELF           */ {NAX, TYPE_FLOAT|VF_DIRECTREAD|VF_DIRECTWRITE|VF_FLASH, ServoDirectReadWrite(VelF)},
/* 180 ENDIL          */ {NAX, TYPE_FLOAT|VF_DIRECTREAD|VF_DIRECTWRITE|VF_FLASH|CAT_POS, ServoDirectReadWrite(EncDiL)},
/* 181 PEL            */ {NAX, TYPE_FLOAT|VF_DIRECTREAD|VF_DIRECTWRITE|VF_FLASH|CAT_POS, ServoDirectReadWrite(PeL)},
/* 182 CURL           */ {NAX, TYPE_FLOAT|VF_DIRECTREAD|VF_DIRECTWRITE|VF_FLASH|CAT_PERCENT, ServoDirectReadWrite(CurL)},
/* 183 PWML           */ {NAX, TYPE_FLOAT|VF_DIRECTREAD|VF_DIRECTWRITE|VF_FLASH|CAT_PERCENT, ServoDirectReadWrite(PwmL)},
/* 184 NSL            */ {NAX, TYPE_FLOAT|VF_DIRECTREAD|VF_DIRECTWRITE|VF_FLASH|CAT_POS, ServoDirectReadWrite(NsL)},
/* 185 PSL            */ {NAX, TYPE_FLOAT|VF_DIRECTREAD|VF_DIRECTWRITE|VF_FLASH|CAT_POS, ServoDirectReadWrite(PsL)},
/* 186 MTL            */ {NAX, TYPE_FLOAT|VF_DIRECTREAD|VF_DIRECTWRITE|VF_FLASH, ServoDirectReadWrite(MtL)},
/* 187 OTL            */ {NAX, TYPE_FLOAT|VF_DIRECTREAD|VF_DIRECTWRITE|VF_FLASH, ServoDirectReadWrite(OtL)},
/* 188                */ {0},
/* 189                */ {0},
/* 190                */ {0},    //    {DirectFull(NAX, Srv, Control.Commut.Offset)},
/* 191                */ {0},    //    {DirectIntFull(NAX, Srv, Control.Commut.Offset, int16_t)},
/* 192                */ {0},    //    {DirectFull(NAX, Srv, Control.Commut.CountToPhase)},
/* 193                */ {0},    //    {DirectFull(NAX, Srv, PhaseAtInd)},
/* 194                */ {0},    //   {DirectFull(NAX, Srv, PosAtInd)},
/* 195                */ {0},    //   {DirectFull(NAX, Srv, ErrorAtInd)},
/* 196                */ {0},    //   {DirectFull(NAX, Srv, Control.DOL)},
/* 197                */ {0},    //   {DirectIntFull(NAX, Srv, Control.Motor, uint16_t)},
/* 198                */ {0},
/* 199                */ {0},
/* 200 ENR            */ {NAX, TYPE_FLOAT|VF_DIRECTREAD|VF_DIRECTWRITE|VF_FLASH, ServoDirectReadWrite(LResolution)},
/* 201 EOFF           */ {0},
/* 202 ENR1           */ {NAX, TYPE_FLOAT|VF_DIRECTREAD|VF_DIRECTWRITE|VF_FLASH, ServoDirectReadWrite(RResolution)},
/* 203 EOFF1          */ {0},
/* 204 COMP           */ {NAX, TYPE_INT32|VF_DIRECTREAD|VF_DIRECTWRITE, ServoDirectReadWrite(CommutPeriod)},
/* 205                */ {0},    //    {DirectScalar(MaxLoad)},
/* 206 PKP            */ {NAX, TYPE_FLOAT|VF_DIRECTREAD|VF_DIRECTWRITE|VF_FLASH, ServoDirectReadWrite(Ploop.Pi.Kp)},
/* 207 PKI            */ {NAX, TYPE_FLOAT|VF_DIRECTREAD|VF_DIRECTWRITE|VF_FLASH, ServoDirectReadWrite(Ploop.Pi.Ki)},
/* 208 PLI            */ {NAX, TYPE_FLOAT|VF_DIRECTREAD|VF_DIRECTWRITE|VF_FLASH, ServoDirectReadWrite(Ploop.Pi.Li)},
/* 209 VKP            */ {NAX, TYPE_FLOAT|VF_DIRECTREAD|VF_DIRECTWRITE|VF_FLASH, ServoDirectReadWrite(Vloop.Pi.Kp)},
/* 210 VKI            */ {NAX, TYPE_FLOAT|VF_DIRECTREAD|VF_DIRECTWRITE|VF_FLASH, ServoDirectReadWrite(Vloop.Pi.Ki)},
/* 211 VLI            */ {NAX, TYPE_FLOAT|VF_DIRECTREAD|VF_DIRECTWRITE|VF_FLASH, ServoDirectReadWrite(Vloop.Pi.Li)},
/* 212 CKP            */ {NAX, TYPE_FLOAT|VF_DIRECTREAD|VF_DIRECTWRITE|VF_FLASH, ServoDirectReadWrite(Cdloop.Pi.Kp)},
/* 213 CKI            */ {NAX, TYPE_FLOAT|VF_DIRECTREAD|VF_DIRECTWRITE|VF_FLASH, ServoDirectReadWrite(Cdloop.Pi.Ki)},
/* 214 CLI            */ {NAX, TYPE_FLOAT|VF_DIRECTREAD|VF_DIRECTWRITE|VF_FLASH, ServoDirectReadWrite(Cdloop.Pi.Li)},
/* 215                */ {0},
/* 216                */ {0},
/* 217                */ {0},
/* 218                */ {0},
/* 219                */ {0},
/* 220 BQENABLE       */ {NAX, TYPE_INT32|VF_DIRECTREAD|VF_DIRECTWRITE|VF_FLASH, ServoDirectReadWrite(Vloop.Bq[0].Enable)},
/* 221 BQMODE         */ {NAX, TYPE_INT32|VF_DIRECTREAD|VF_PROPWRITE|VF_FLASH, ServoDirectRead(Vloop.Bq[0].Mode), WriteBqMode(0)},
/* 222 BQP0           */ {NAX, TYPE_FLOAT|VF_DIRECTREAD|VF_DIRECTWRITE|VF_FLASH, ServoDirectReadWrite(Vloop.Bq[0].P0)},
/* 223 BQP1           */ {NAX, TYPE_FLOAT|VF_DIRECTREAD|VF_DIRECTWRITE|VF_FLASH, ServoDirectReadWrite(Vloop.Bq[0].P1)},
/* 224 BQP2           */ {NAX, TYPE_FLOAT|VF_DIRECTREAD|VF_DIRECTWRITE|VF_FLASH, ServoDirectReadWrite(Vloop.Bq[0].P2)},
/* 225 BQP3           */ {NAX, TYPE_FLOAT|VF_DIRECTREAD|VF_DIRECTWRITE|VF_FLASH, ServoDirectReadWrite(Vloop.Bq[0].P3)},
/* 226 BQP4           */ {NAX, TYPE_FLOAT|VF_DIRECTREAD|VF_DIRECTWRITE|VF_FLASH, ServoDirectReadWrite(Vloop.Bq[0].P4)},
/* 227 BQA1           */ {NAX, TYPE_FLOAT|VF_DIRECTREAD|VF_PROPWRITE|VF_FLASH, ServoDirectRead(Vloop.Bq[0].A1), WriteBqRaw(0, A1)},
/* 228 BQA2           */ {NAX, TYPE_FLOAT|VF_DIRECTREAD|VF_PROPWRITE|VF_FLASH, ServoDirectRead(Vloop.Bq[0].A2), WriteBqRaw(0, A2)},
/* 229 BQB0           */ {NAX, TYPE_FLOAT|VF_DIRECTREAD|VF_PROPWRITE|VF_FLASH, ServoDirectRead(Vloop.Bq[0].B0), WriteBqRaw(0, B0)},
/* 230 BQB1           */ {NAX, TYPE_FLOAT|VF_DIRECTREAD|VF_PROPWRITE|VF_FLASH, ServoDirectRead(Vloop.Bq[0].B1), WriteBqRaw(0, B1)},
/* 231 BQB2           */ {NAX, TYPE_FLOAT|VF_DIRECTREAD|VF_PROPWRITE|VF_FLASH, ServoDirectRead(Vloop.Bq[0].B2), WriteBqRaw(0, B2)},
/* 232 BQ1ENABLE      */ {NAX, TYPE_INT32|VF_DIRECTREAD|VF_DIRECTWRITE|VF_FLASH, ServoDirectReadWrite(Vloop.Bq[1].Enable)},
/* 233 BQ1MODE        */ {NAX, TYPE_INT32|VF_DIRECTREAD|VF_PROPWRITE|VF_FLASH, ServoDirectRead(Vloop.Bq[1].Mode), WriteBqMode(1)},
/* 234 BQ1P0          */ {NAX, TYPE_FLOAT|VF_DIRECTREAD|VF_DIRECTWRITE|VF_FLASH, ServoDirectReadWrite(Vloop.Bq[1].P0)},
/* 235 BQ1P1          */ {NAX, TYPE_FLOAT|VF_DIRECTREAD|VF_DIRECTWRITE|VF_FLASH, ServoDirectReadWrite(Vloop.Bq[1].P1)},
/* 236 BQ1P2          */ {NAX, TYPE_FLOAT|VF_DIRECTREAD|VF_DIRECTWRITE|VF_FLASH, ServoDirectReadWrite(Vloop.Bq[1].P2)},
/* 237 BQ1P3          */ {NAX, TYPE_FLOAT|VF_DIRECTREAD|VF_DIRECTWRITE|VF_FLASH, ServoDirectReadWrite(Vloop.Bq[1].P3)},
/* 238 BQ1P4          */ {NAX, TYPE_FLOAT|VF_DIRECTREAD|VF_DIRECTWRITE|VF_FLASH, ServoDirectReadWrite(Vloop.Bq[1].P4)},
/* 239 BQ1A1          */ {NAX, TYPE_FLOAT|VF_DIRECTREAD|VF_PROPWRITE|VF_FLASH, ServoDirectRead(Vloop.Bq[1].A1), WriteBqRaw(1, A1)},
/* 240 BQ1A2          */ {NAX, TYPE_FLOAT|VF_DIRECTREAD|VF_PROPWRITE|VF_FLASH, ServoDirectRead(Vloop.Bq[1].A2), WriteBqRaw(1, A2)},
/* 241 BQ1B0          */ {NAX, TYPE_FLOAT|VF_DIRECTREAD|VF_PROPWRITE|VF_FLASH, ServoDirectRead(Vloop.Bq[1].B0), WriteBqRaw(1, B0)},
/* 242 BQ1B1          */ {NAX, TYPE_FLOAT|VF_DIRECTREAD|VF_PROPWRITE|VF_FLASH, ServoDirectRead(Vloop.Bq[1].B1), WriteBqRaw(1, B1)},
/* 243 BQ1B2          */ {NAX, TYPE_FLOAT|VF_DIRECTREAD|VF_PROPWRITE|VF_FLASH, ServoDirectRead(Vloop.Bq[1].B2), WriteBqRaw(1, B2)},
/* 244 BQ2ENABLE      */ {NAX, TYPE_INT32|VF_DIRECTREAD|VF_DIRECTWRITE|VF_FLASH, ServoDirectReadWrite(Vloop.Bq[2].Enable)},
/* 245 BQ2MODE        */ {NAX, TYPE_INT32|VF_DIRECTREAD|VF_PROPWRITE|VF_FLASH, ServoDirectRead(Vloop.Bq[2].Mode), WriteBqMode(2)},
/* 246 BQ2P0          */ {NAX, TYPE_FLOAT|VF_DIRECTREAD|VF_DIRECTWRITE|VF_FLASH, ServoDirectReadWrite(Vloop.Bq[2].P0)},
/* 247 BQ2P1          */ {NAX, TYPE_FLOAT|VF_DIRECTREAD|VF_DIRECTWRITE|VF_FLASH, ServoDirectReadWrite(Vloop.Bq[2].P1)},
/* 248 BQ2P2          */ {NAX, TYPE_FLOAT|VF_DIRECTREAD|VF_DIRECTWRITE|VF_FLASH, ServoDirectReadWrite(Vloop.Bq[2].P2)},
/* 249 BQ2P3          */ {NAX, TYPE_FLOAT|VF_DIRECTREAD|VF_DIRECTWRITE|VF_FLASH, ServoDirectReadWrite(Vloop.Bq[2].P3)},
/* 250 BQ2P4          */ {NAX, TYPE_FLOAT|VF_DIRECTREAD|VF_DIRECTWRITE|VF_FLASH, ServoDirectReadWrite(Vloop.Bq[2].P4)},
/* 251 BQ2A1          */ {NAX, TYPE_FLOAT|VF_DIRECTREAD|VF_PROPWRITE|VF_FLASH, ServoDirectRead(Vloop.Bq[2].A1), WriteBqRaw(2, A1)},
/* 252 BQ2A2          */ {NAX, TYPE_FLOAT|VF_DIRECTREAD|VF_PROPWRITE|VF_FLASH, ServoDirectRead(Vloop.Bq[2].A2), WriteBqRaw(2, A2)},
/* 253 BQ2B0          */ {NAX, TYPE_FLOAT|VF_DIRECTREAD|VF_PROPWRITE|VF_FLASH, ServoDirectRead(Vloop.Bq[2].B0), WriteBqRaw(2, B0)},
/* 254 BQ2B1          */ {NAX, TYPE_FLOAT|VF_DIRECTREAD|VF_PROPWRITE|VF_FLASH, ServoDirectRead(Vloop.Bq[2].B1), WriteBqRaw(2, B1)},
/* 255 BQ2B2          */ {NAX, TYPE_FLOAT|VF_DIRECTREAD|VF_PROPWRITE|VF_FLASH, ServoDirectRead(Vloop.Bq[2].B2), WriteBqRaw(2, B2)},
/* 256 BQ3ENABLE      */ {NAX, TYPE_INT32|VF_DIRECTREAD|VF_DIRECTWRITE|VF_FLASH, ServoDirectReadWrite(Vloop.Bq[3].Enable)},
/* 257 BQ3MODE        */ {NAX, TYPE_INT32|VF_DIRECTREAD|VF_PROPWRITE|VF_FLASH, ServoDirectRead(Vloop.Bq[3].Mode), WriteBqMode(3)},
/* 258 BQ3P0          */ {NAX, TYPE_FLOAT|VF_DIRECTREAD|VF_DIRECTWRITE|VF_FLASH, ServoDirectReadWrite(Vloop.Bq[3].P0)},
/* 259 BQ3P1          */ {NAX, TYPE_FLOAT|VF_DIRECTREAD|VF_DIRECTWRITE|VF_FLASH, ServoDirectReadWrite(Vloop.Bq[3].P1)},
/* 260 BQ3P2          */ {NAX, TYPE_FLOAT|VF_DIRECTREAD|VF_DIRECTWRITE|VF_FLASH, ServoDirectReadWrite(Vloop.Bq[3].P2)},
/* 261 BQ3P3          */ {NAX, TYPE_FLOAT|VF_DIRECTREAD|VF_DIRECTWRITE|VF_FLASH, ServoDirectReadWrite(Vloop.Bq[3].P3)},
/* 262 BQ3P4          */ {NAX, TYPE_FLOAT|VF_DIRECTREAD|VF_DIRECTWRITE|VF_FLASH, ServoDirectReadWrite(Vloop.Bq[3].P4)},
/* 263 BQ3A1          */ {NAX, TYPE_FLOAT|VF_DIRECTREAD|VF_PROPWRITE|VF_FLASH, ServoDirectRead(Vloop.Bq[3].A1), WriteBqRaw(3, A1)},
/* 264 BQ3A2          */ {NAX, TYPE_FLOAT|VF_DIRECTREAD|VF_PROPWRITE|VF_FLASH, ServoDirectRead(Vloop.Bq[3].A2), WriteBqRaw(3, A2)},
/* 265 BQ3B0          */ {NAX, TYPE_FLOAT|VF_DIRECTREAD|VF_PROPWRITE|VF_FLASH, ServoDirectRead(Vloop.Bq[3].B0), WriteBqRaw(3, B0)},
/* 266 BQ3B1          */ {NAX, TYPE_FLOAT|VF_DIRECTREAD|VF_PROPWRITE|VF_FLASH, ServoDirectRead(Vloop.Bq[3].B1), WriteBqRaw(3, B1)},
/* 267 BQ3B2          */ {NAX, TYPE_FLOAT|VF_DIRECTREAD|VF_PROPWRITE|VF_FLASH, ServoDirectRead(Vloop.Bq[3].B2), WriteBqRaw(3, B2)},
/* 268 ROCIN          */ {NAX, TYPE_UINT8|VF_DIRECTREAD|VF_PROPWRITE, ServoDirectRead(CInRout), WriteSignalRout(RO_CIN)},
/* 269 ROVIN          */ {NAX, TYPE_UINT8|VF_DIRECTREAD|VF_PROPWRITE, ServoDirectRead(VInRout), WriteSignalRout(RO_VIN)},
/* 270 ROTPOS         */ {NAX, TYPE_UINT8|VF_DIRECTREAD|VF_PROPWRITE, ServoDirectRead(TPosRout), WriteSignalRout(RO_TPOS)},
/* 271 ROTVEL         */ {NAX, TYPE_UINT8|VF_DIRECTREAD|VF_PROPWRITE, ServoDirectRead(TVelRout), WriteSignalRout(RO_RVEL)},
/* 272 RORPOS         */ {NAX, TYPE_UINT8|VF_DIRECTREAD|VF_PROPWRITE, ServoDirectRead(RPosRout), WriteSignalRout(RO_RPOS)},
/* 273                */ {0},
/* 274 FUNC           */ {0}, // {1,  TYPE_UINT32|VF_PROPWRITE, 0, FunctionCall},
/* 275 FIPAR          */ {0}, // {10, TYPE_INT32|VF_DIRECTWRITE, (int32_t*)Functions.Ip, 0},
/* 276 FFPAR          */ {0}, // {10, TYPE_FLOAT|VF_DIRECTWRITE, (int32_t*)Functions.Fp, 0},
/* 277                */ {0},
/* 278                */ {0},
/* 279                */ {0},
/* 280 AIN            */ {24, TYPE_FLOAT|VF_DIRECTREAD|CAT_PERCENT, StructScalarDirectReadArray(Adc, Ain, 24), 0},
/* 281 AINMIN         */ {0}, //{12, TYPE_FLOAT|VF_DIRECTREAD|VF_DIRECTWRITE|VF_FLASH, (int32_t*)Adc.AinMin, 0},
/* 282 AINMAX         */ {0}, //{12, TYPE_FLOAT|VF_DIRECTREAD|VF_DIRECTWRITE|VF_FLASH, (int32_t*)Adc.AinMax, 0},
/* 283 AINFILT        */ {0}, //{12, TYPE_FLOAT|VF_DIRECTREAD|VF_DIRECTWRITE|VF_FLASH, (int32_t*)Adc.Filter, 0},
/* 284                */ {0},
/* 285                */ {0},
/* 286                */ {0},
/* 287                */ {0},
/* 288                */ {0},
/* 289                */ {0},
/* 290 LATE           */ {0}, //{1, TYPE_FLOAT|VF_DIRECTREAD, (int32_t*)&Timer.Late, 0},
/* 291 USE            */ {0}, //{1, TYPE_FLOAT|VF_DIRECTREAD, (int32_t*)&Timer.Use, 0},
/* 292 XLATE          */ {0}, //{1, TYPE_FLOAT|VF_DIRECTREAD|VF_DIRECTWRITE, (int32_t*)&Timer.XLate, 0},
/* 293 XUSE           */ {0}, //{1, TYPE_FLOAT|VF_DIRECTREAD|VF_DIRECTWRITE, (int32_t*)&Timer.XUse, 0},
/* 294                */ {0},
/* 295                */ {0},
/* 296                */ {0},
/* 297                */ {0},
/* 298                */ {0},
/* 299                */ {0},
/* 300                */ {0},
/* 301                */ {0},
/* 302 FAULTMASK      */ {0},
/* 303 AFAULTMASK     */ {NAX, TYPE_UINT32|VF_DIRECTREAD|VF_DIRECTWRITE, ServoDirectReadWrite(FaultMask)},
/* 304 FAULTKILL      */ {0}, 
/* 305 AFAULTKILL     */ {NAX, TYPE_UINT32|VF_DIRECTREAD|VF_DIRECTWRITE, ServoDirectReadWrite(FaultKill)},
/* 306 FAULTDISABLE   */ {0},
/* 307 AFAULTDISABLE  */ {NAX, TYPE_UINT32|VF_DIRECTREAD|VF_DIRECTWRITE, ServoDirectReadWrite(FaultDisable)},
/* 308                */ {0},
/* 309                */ {0},
/* 310                */ {0},
/* 311                */ {0},
/* 312 AOUT           */ {0}, // {2,  TYPE_FLOAT|VF_DIRECTREAD|VF_DIRECTWRITE, (int32_t*)Dac.Aout, 0},
/* 313 MOID           */ {0}, // {2,  TYPE_UINT32|VF_DIRECTREAD|VF_PROPWRITE, (int32_t*)Dac.MonId, WriteMonId},
/* 314 MOADDR         */ {0}, // {10, TYPE_UINT32|VF_DIRECTREAD|VF_PROPWRITE, (int32_t*)Dac.MonAddr, WriteMonAddr},
/* 315 MOFACT         */ {0}, // {2,  TYPE_FLOAT|VF_DIRECTREAD|VF_DIRECTWRITE, (int32_t*)Dac.MonFact, 0},
/* 316 MOOFFS         */ {0}, // {2,  TYPE_FLOAT|VF_DIRECTREAD|VF_DIRECTWRITE, (int32_t*)Dac.MonOffs, 0},
/* 317                */ {0},
/* 318                */ {0},
/* 319                */ {0},
/* 320 AB4NP          */ {0}, //{1, TYPE_UINT32|VF_DIRECTREAD|VF_PROPWRITE|VF_FLASH, (int32_t*)&Pwm.Ab4.Npoints, WriteNab4Points},
/* 321 AB4IN          */ {0}, //{20, TYPE_FLOAT|VF_DIRECTREAD|VF_PROPWRITE|VF_FLASH, (int32_t*)&Pwm.Ab4.In, WriteAb4in},
/* 322 AB4ACT         */ {0}, //{20, TYPE_FLOAT|VF_DIRECTREAD|VF_PROPWRITE|VF_FLASH, (int32_t*)&Pwm.Ab4.Aout, WriteAb4aout},
/* 323 AB4INACT       */ {0}, //{20, TYPE_FLOAT|VF_DIRECTREAD|VF_PROPWRITE|VF_FLASH, (int32_t*)&Pwm.Ab4.Iout, WriteAb4iout},
/* 324 AB4FREQ        */ {0}, //{20, TYPE_FLOAT|VF_DIRECTREAD|VF_PROPWRITE|VF_FLASH, (int32_t*)&Pwm.Ab4.Freq, WriteAb4frq},
/* 325 AB5NP          */ {0}, //{1, TYPE_UINT32|VF_DIRECTREAD|VF_PROPWRITE|VF_FLASH, (int32_t*)&Pwm.Ab5.Npoints, WriteNab5Points},
/* 326 AB5IN          */ {0}, //{20, TYPE_FLOAT|VF_DIRECTREAD|VF_PROPWRITE|VF_FLASH, (int32_t*)&Pwm.Ab5.In, WriteAb5in},
/* 327 AB5ACT         */ {0}, //{20, TYPE_FLOAT|VF_DIRECTREAD|VF_PROPWRITE|VF_FLASH, (int32_t*)&Pwm.Ab5.Aout, WriteAb5aout},
/* 328 AB5INACT       */ {0}, //{20, TYPE_FLOAT|VF_DIRECTREAD|VF_PROPWRITE|VF_FLASH, (int32_t*)&Pwm.Ab5.Iout, WriteAb5iout},
/* 329 AB5FREQ        */ {0}, //{20, TYPE_FLOAT|VF_DIRECTREAD|VF_PROPWRITE|VF_FLASH, (int32_t*)&Pwm.Ab5.Freq, WriteAb5frq},
/* 330 SAF            */ {0}, //{1, TYPE_UINT32|VF_DIRECTREAD, (int32_t*)&Servo.Safety, 0},
/* 331 SAFRAW         */ {0}, //{1, TYPE_UINT32|VF_DIRECTREAD, (int32_t*)&Servo.SafetyRaw, 0},
/* 332 SAFMASK        */ {0}, //{1, TYPE_UINT32|VF_DIRECTREAD|VF_DIRECTWRITE|VF_FLASH, (int32_t*)&Servo.SafetyMask, 0},
/* 333 FAULT          */ {0}, //{1, TYPE_UINT16|VF_PROPREAD|VF_PROPWRITE, 0, ReadWriteError},
/* 334                */ {0},
/* 335                */ {0},
/* 336                */ {0},
/* 337                */ {0},
/* 338                */ {0},
/* 339                */ {0},
/* 340 SGMOD          */ {2, TYPE_UINT8|VF_DIRECTREAD|VF_DIRECTWRITE, StructDirectReadWriteShort(Signals, Type, 2, uint8_t)},
/* 341 SGPRD          */ {2, TYPE_FLOAT|VF_DIRECTREAD|VF_PROPWRITE, StructDirectRead(Signals, Period, 2), SignalSetPeriod},
/* 342 SGDUT          */ {2, TYPE_FLOAT|VF_DIRECTREAD|VF_DIRECTWRITE, StructDirectReadWrite(Signals, Duty, 2)},
/* 343 SGMIN          */ {2, TYPE_FLOAT|VF_DIRECTREAD|VF_DIRECTWRITE, StructDirectReadWrite(Signals, Min, 2)},
/* 344 SGMAX          */ {2, TYPE_FLOAT|VF_DIRECTREAD|VF_DIRECTWRITE, StructDirectReadWrite(Signals, Max, 2)},
/* 345 SGFILT         */ {2, TYPE_FLOAT|VF_DIRECTREAD|VF_DIRECTWRITE, StructDirectReadWrite(Signals, Filt, 2)},
/* 346 SGN            */ {2, TYPE_FLOAT|VF_DIRECTREAD|VF_DIRECTWRITE, StructDirectReadWrite(Signals, Sgn, 2)},
